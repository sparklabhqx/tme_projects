/*
 * HALLOWEEN ARCADE — Arduino GIGA R1 WiFi + GIGA Display Shield
 *
 *   Pumpkin Whack  — smash jack-o'-lanterns, spare the ghosts
 *   Flappy Bat     — tap to flap through the graveyard gates
 *   Cauldron Catch — drag the cauldron, catch treats, dodge skulls
 *
 * All art is generated by tools/gen_assets.py (pycairo) and baked into flash
 * pre-rotated for the panel's portrait memory; the engine blits with DMA2D.
 *
 * Serial debug protocol @115200 (see tools/devtool.py):
 *   S        dump the displayed framebuffer as raw RGB565
 *   T x y    tap once at landscape (x,y)
 *   H x y    press and hold / U release
 *   I        print fps + touch state
 */
#include <Arduino_H7_Video.h>
#include <SDRAM.h>
#include "engine.h"
#include "scenes.h"

Arduino_H7_Video Display(480, 800, GigaDisplayShield);

void menuComposeBg();
void whackComposeBg();
void batComposeBg();
void catchComposeBg();

static Scene lastScene = (Scene)-1;

void setup() {
  Serial.begin(115200);
  Display.begin();
  eng::begin();

  bgMenu  = eng::allocLayer();
  bgWhack = eng::allocLayer();
  bgBat   = eng::allocLayer();
  bgCatch = eng::allocLayer();

  eng::clear(0x0000);
  eng::textCenter(font_big, "SUMMONING", SCREEN_W / 2, 230, ARGB(255, 255, 150, 40));
  eng::textCenter(font_small, "BREWING THE GRAVEYARD", SCREEN_W / 2, 270, ARGB(255, 180, 160, 220));
  eng::present();

  menuComposeBg();
  whackComposeBg();
  batComposeBg();
  catchComposeBg();

  gScene = SC_MENU;
}

void loop() {
  eng::frameStart();

  if (gScene != lastScene) {
    lastScene = gScene;
    eng::clearClip();
    eng::shakeX = eng::shakeY = 0;
    switch (gScene) {
      case SC_MENU:  menuEnter();  break;
      case SC_WHACK: whackEnter(); break;
      case SC_BAT:   batEnter();   break;
      case SC_CATCH: catchEnter(); break;
    }
  }

  uint32_t t0 = micros();
  switch (gScene) {
    case SC_MENU:  menuTick();  break;
    case SC_WHACK: whackTick(); break;
    case SC_BAT:   batTick();   break;
    case SC_CATCH: catchTick(); break;
  }
  uint32_t t1 = micros();
  eng::present();
  eng::msScene = (t1 - t0) / 1000.0f;
  eng::msPresent = (micros() - t1) / 1000.0f;
}
